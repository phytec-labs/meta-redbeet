## conf/layer.conf
```bitbake
# We have a conf and classes directory, add to BBPATH
BBPATH .= ":${LAYERDIR}"

# We have recipes-* directories, add to BBFILES
BBFILES += "${LAYERDIR}/recipes-*/*/*.bb \
            ${LAYERDIR}/recipes-*/*/*.bbappend"

BBFILE_COLLECTIONS += "meta-redbeet"
BBFILE_PATTERN_meta-redbeet = "^${LAYERDIR}/"
BBFILE_PRIORITY_meta-redbeet = "50"

LAYERDEPENDS_meta-redbeet = "core"
LAYERSERIES_COMPAT_meta-redbeet = "dunfell"

# Install our software bb recipe
IMAGE_INSTALL_append = " open-plc-utils"

# Append our device tree overlay to the kernel
KERNEL_DEVICETREE:append = " ti/k3-am62-phyboard-lyra-redbeet.dtbo"
```
